
&xiaomi_touch {
 	status = "okay";
 	compatible = "xiaomi-touch";
	touch,name = "xiaomi-touch";
};

&i2c0 {
    focaltech@38 {
        compatible = "focaltech,fts";
        reg = <0x38>;
        interrupt-parent = <&pio>;
        interrupts = <22 0x02>;
        vtouch-supply = <&mt6369_vtp>;
        //focaltech,avdd-gpio = <&pio 159 0>;
        focaltech,reset-gpio = <&pio 3 0x01>;
        focaltech,irq-gpio = <&pio 22 0x02>;
        focaltech,max-touch-number = <10>;
        focaltech,display-coords =  <0 0 17279 38399>;
        //panel = <&dsi_panel_o17_38_0c_0a_fhdp_vdo>;
        //pinctrl-names = "pmx_ts_active","pmx_ts_suspend","pmx_ts_release";
        //pinctrl-0 = <&ts_int_active &ts_reset_active &ts_avdd>;
        //pinctrl-1 = <&ts_int_suspend &ts_reset_suspend>;
        //pinctrl-2 = <&ts_release>;
        status = "okay";
    };
};
